## app/boards/arm/wEnki42/Kconfig.board
```kconfig
# wEnki42 board configuration

# Copyright (c) 2021 The ZMK Contributors
# SPDX-License-Identifier: MIT

config BOARD_WENKI42_LEFT
	bool "wenki42_left"
	depends on SOC_NRF52840_QIAA

config BOARD_WENKI42_RIGHT
	bool "wenki42_right"
	depends on SOC_NRF52840_QIAA
```

## app/boards/arm/wEnki42/Kconfig.defconfig
```kconfig
# Copyright (c) 2021 The ZMK Contributors
# SPDX-License-Identifier: MIT

if BOARD_WENKI42_LEFT

	config ZMK_KEYBOARD_NAME
	default "wEnki42"

endif # BOARD_WENKI42_LEFT


if BOARD_WENKI42_LEFT || BOARD_WENKI42_RIGHT

config BOARD
	default "wenki42"

config ZMK_SPLIT
	default y

menuconfig SENSOR
    bool "Sensor Drivers"

config BT_CTLR
	default BT

config ZMK_BLE
	default y

config ZMK_USB
	default y

if USB

config USB_NRFX
	default y

config USB_DEVICE_STACK
	default y

endif # USB

endif # BOARD_WENKI42_LEFT || BOARD_WENKI42_RIGHT
```
